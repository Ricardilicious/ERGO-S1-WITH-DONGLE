#include "ergo_s1.dtsi"

/* Left half: C0 (outermost) .. C5 (innermost) */
&kscan0 {
    col-gpios
        = <&pro_micro 4 GPIO_ACTIVE_HIGH>  /* C0 */
        , <&pro_micro 5 GPIO_ACTIVE_HIGH>  /* C1 */
        , <&pro_micro 6 GPIO_ACTIVE_HIGH>  /* C2 */
        , <&pro_micro 7 GPIO_ACTIVE_HIGH>  /* C3 */
        , <&pro_micro 8 GPIO_ACTIVE_HIGH>  /* C4 */
        , <&pro_micro 9 GPIO_ACTIVE_HIGH>  /* C5 */
        ;
};
