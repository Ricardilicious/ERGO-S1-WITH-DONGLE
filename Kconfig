## Kconfig
```kconfig
config ERGO_S1_DONGLE_SCREEN
    bool "Ergo S1 dongle OLED status screen (batteries, output, WPM, layer, typing animation)"
    default y if SHIELD_ERGO_S1_DONGLE && ZMK_DISPLAY_STATUS_SCREEN_CUSTOM
    depends on ZMK_DISPLAY && ZMK_SPLIT_BLE_CENTRAL_BATTERY_LEVEL_FETCHING
    select LV_USE_LABEL
    select LV_FONT_MONTSERRAT_12
    select LV_FONT_MONTSERRAT_16
    select ZMK_WIDGET_LAYER_STATUS
    select ZMK_WPM
    imply LV_USE_THEME_MONO

if ERGO_S1_DONGLE_SCREEN

config LV_Z_MEM_POOL_SIZE
    default 16384

endif
```

## boards/shields/ergo_s1/Kconfig.shield
```kconfig
config SHIELD_ERGO_S1_LEFT
    def_bool $(shields_list_contains,ergo_s1_left)

config SHIELD_ERGO_S1_RIGHT
    def_bool $(shields_list_contains,ergo_s1_right)

config SHIELD_ERGO_S1_DONGLE
    def_bool $(shields_list_contains,ergo_s1_dongle)
```
